// Guition JC3248W535: ESP32-S3 N16R8, 3.5" 320x480 AXS15231B over QSPI,
// capacitive touch inside the same AXS15231B on I2C (0x3B).
#include "board.h"
#include "driver/gpio.h"
#include "driver/ledc.h"
#include "driver/spi_master.h"
#include "driver/i2c_master.h"
#include "esp_heap_caps.h"
#include "esp_lcd_panel_io.h"
#include "esp_lcd_panel_ops.h"
#include "esp_lcd_axs15231b.h"
#include "freertos/FreeRTOS.h"
#include "freertos/semphr.h"
#include <string.h>
#include "esp_timer.h"
#include "axs_type1_init.h"

#define PIN_LCD_CS   GPIO_NUM_45
#define PIN_LCD_SCK  GPIO_NUM_47
#define PIN_LCD_D0   GPIO_NUM_21
#define PIN_LCD_D1   GPIO_NUM_48
#define PIN_LCD_D2   GPIO_NUM_40
#define PIN_LCD_D3   GPIO_NUM_39
#define PIN_LCD_BL   GPIO_NUM_1
#define PIN_TP_SDA   GPIO_NUM_4
#define PIN_TP_SCL   GPIO_NUM_8
#define TP_ADDR      0x3B

#define STRIP_ROWS   40
#define STRIP_PIXELS (DISP_W * STRIP_ROWS)

static esp_lcd_panel_handle_t panel;
static SemaphoreHandle_t strip_free;
static uint16_t *strip[2];
static i2c_master_dev_handle_t tp_dev;

// Init sequence for the 320x480 QSPI AXS15231B module (from Espressif's
// esp_lcd_axs15231b QSPI test, which targets this exact panel and pinout).
static const axs15231b_lcd_init_cmd_t lcd_init_cmds[] = {
    {0xBB, (uint8_t[]){0x00, 0x00, 0x00, 0x00, 0x00, 0x00, 0x5A, 0xA5}, 8, 0},
    {0xA0, (uint8_t[]){0xC0, 0x10, 0x00, 0x02, 0x00, 0x00, 0x04, 0x3F, 0x20, 0x05, 0x3F, 0x3F, 0x00, 0x00, 0x00, 0x00, 0x00}, 17, 0},
    {0xA2, (uint8_t[]){0x30, 0x3C, 0x24, 0x14, 0xD0, 0x20, 0xFF, 0xE0, 0x40, 0x19, 0x80, 0x80, 0x80, 0x20, 0xf9, 0x10, 0x02, 0xff, 0xff, 0xF0, 0x90, 0x01, 0x32, 0xA0, 0x91, 0xE0, 0x20, 0x7F, 0xFF, 0x00, 0x5A}, 31, 0},
    {0xD0, (uint8_t[]){0xE0, 0x40, 0x51, 0x24, 0x08, 0x05, 0x10, 0x01, 0x20, 0x15, 0x42, 0xC2, 0x22, 0x22, 0xAA, 0x03, 0x10, 0x12, 0x60, 0x14, 0x1E, 0x51, 0x15, 0x00, 0x8A, 0x20, 0x00, 0x03, 0x3A, 0x12}, 30, 0},
    {0xA3, (uint8_t[]){0xA0, 0x06, 0xAa, 0x00, 0x08, 0x02, 0x0A, 0x04, 0x04, 0x04, 0x04, 0x04, 0x04, 0x04, 0x04, 0x04, 0x04, 0x04, 0x04, 0x00, 0x55, 0x55}, 22, 0},
    {0xC1, (uint8_t[]){0x31, 0x04, 0x02, 0x02, 0x71, 0x05, 0x24, 0x55, 0x02, 0x00, 0x41, 0x00, 0x53, 0xFF, 0xFF, 0xFF, 0x4F, 0x52, 0x00, 0x4F, 0x52, 0x00, 0x45, 0x3B, 0x0B, 0x02, 0x0d, 0x00, 0xFF, 0x40}, 30, 0},
    {0xC3, (uint8_t[]){0x00, 0x00, 0x00, 0x50, 0x03, 0x00, 0x00, 0x00, 0x01, 0x80, 0x01}, 11, 0},
    {0xC4, (uint8_t[]){0x00, 0x24, 0x33, 0x80, 0x00, 0xea, 0x64, 0x32, 0xC8, 0x64, 0xC8, 0x32, 0x90, 0x90, 0x11, 0x06, 0xDC, 0xFA, 0x00, 0x00, 0x80, 0xFE, 0x10, 0x10, 0x00, 0x0A, 0x0A, 0x44, 0x50}, 29, 0},
    {0xC5, (uint8_t[]){0x18, 0x00, 0x00, 0x03, 0xFE, 0x3A, 0x4A, 0x20, 0x30, 0x10, 0x88, 0xDE, 0x0D, 0x08, 0x0F, 0x0F, 0x01, 0x3A, 0x4A, 0x20, 0x10, 0x10, 0x00}, 23, 0},
    {0xC6, (uint8_t[]){0x05, 0x0A, 0x05, 0x0A, 0x00, 0xE0, 0x2E, 0x0B, 0x12, 0x22, 0x12, 0x22, 0x01, 0x03, 0x00, 0x3F, 0x6A, 0x18, 0xC8, 0x22}, 20, 0},
    {0xC7, (uint8_t[]){0x50, 0x32, 0x28, 0x00, 0xa2, 0x80, 0x8f, 0x00, 0x80, 0xff, 0x07, 0x11, 0x9c, 0x67, 0xff, 0x24, 0x0c, 0x0d, 0x0e, 0x0f}, 20, 0},
    {0xC9, (uint8_t[]){0x33, 0x44, 0x44, 0x01}, 4, 0},
    {0xCF, (uint8_t[]){0x2C, 0x1E, 0x88, 0x58, 0x13, 0x18, 0x56, 0x18, 0x1E, 0x68, 0x88, 0x00, 0x65, 0x09, 0x22, 0xC4, 0x0C, 0x77, 0x22, 0x44, 0xAA, 0x55, 0x08, 0x08, 0x12, 0xA0, 0x08}, 27, 0},
    {0xD5, (uint8_t[]){0x40, 0x8E, 0x8D, 0x01, 0x35, 0x04, 0x92, 0x74, 0x04, 0x92, 0x74, 0x04, 0x08, 0x6A, 0x04, 0x46, 0x03, 0x03, 0x03, 0x03, 0x82, 0x01, 0x03, 0x00, 0xE0, 0x51, 0xA1, 0x00, 0x00, 0x00}, 30, 0},
    {0xD6, (uint8_t[]){0x10, 0x32, 0x54, 0x76, 0x98, 0xBA, 0xDC, 0xFE, 0x93, 0x00, 0x01, 0x83, 0x07, 0x07, 0x00, 0x07, 0x07, 0x00, 0x03, 0x03, 0x03, 0x03, 0x03, 0x03, 0x00, 0x84, 0x00, 0x20, 0x01, 0x00}, 30, 0},
    {0xD7, (uint8_t[]){0x03, 0x01, 0x0b, 0x09, 0x0f, 0x0d, 0x1E, 0x1F, 0x18, 0x1d, 0x1f, 0x19, 0x40, 0x8E, 0x04, 0x00, 0x20, 0xA0, 0x1F}, 19, 0},
    {0xD8, (uint8_t[]){0x02, 0x00, 0x0a, 0x08, 0x0e, 0x0c, 0x1E, 0x1F, 0x18, 0x1d, 0x1f, 0x19}, 12, 0},
    {0xD9, (uint8_t[]){0x1F, 0x1F, 0x1F, 0x1F, 0x1F, 0x1F, 0x1F, 0x1F, 0x1F, 0x1F, 0x1F, 0x1F}, 12, 0},
    {0xDD, (uint8_t[]){0x1F, 0x1F, 0x1F, 0x1F, 0x1F, 0x1F, 0x1F, 0x1F, 0x1F, 0x1F, 0x1F, 0x1F}, 12, 0},
    {0xDF, (uint8_t[]){0x44, 0x73, 0x4B, 0x69, 0x00, 0x0A, 0x02, 0x90}, 8, 0},
    {0xE0, (uint8_t[]){0x3B, 0x28, 0x10, 0x16, 0x0c, 0x06, 0x11, 0x28, 0x5c, 0x21, 0x0D, 0x35, 0x13, 0x2C, 0x33, 0x28, 0x0D}, 17, 0},
    {0xE1, (uint8_t[]){0x37, 0x28, 0x10, 0x16, 0x0b, 0x06, 0x11, 0x28, 0x5C, 0x21, 0x0D, 0x35, 0x14, 0x2C, 0x33, 0x28, 0x0F}, 17, 0},
    {0xE2, (uint8_t[]){0x3B, 0x07, 0x12, 0x18, 0x0E, 0x0D, 0x17, 0x35, 0x44, 0x32, 0x0C, 0x14, 0x14, 0x36, 0x3A, 0x2F, 0x0D}, 17, 0},
    {0xE3, (uint8_t[]){0x37, 0x07, 0x12, 0x18, 0x0E, 0x0D, 0x17, 0x35, 0x44, 0x32, 0x0C, 0x14, 0x14, 0x36, 0x32, 0x2F, 0x0F}, 17, 0},
    {0xE4, (uint8_t[]){0x3B, 0x07, 0x12, 0x18, 0x0E, 0x0D, 0x17, 0x39, 0x44, 0x2E, 0x0C, 0x14, 0x14, 0x36, 0x3A, 0x2F, 0x0D}, 17, 0},
    {0xE5, (uint8_t[]){0x37, 0x07, 0x12, 0x18, 0x0E, 0x0D, 0x17, 0x39, 0x44, 0x2E, 0x0C, 0x14, 0x14, 0x36, 0x3A, 0x2F, 0x0F}, 17, 0},
    {0xA4, (uint8_t[]){0x85, 0x85, 0x95, 0x82, 0xAF, 0xAA, 0xAA, 0x80, 0x10, 0x30, 0x40, 0x40, 0x20, 0xFF, 0x60, 0x30}, 16, 0},
    {0xA4, (uint8_t[]){0x85, 0x85, 0x95, 0x85}, 4, 0},
    {0xBB, (uint8_t[]){0x00, 0x00, 0x00, 0x00, 0x00, 0x00, 0x00, 0x00}, 8, 0},
    {0x13, (uint8_t[]){0x00}, 0, 0},
    {0x11, (uint8_t[]){0x00}, 0, 120},
    {0x2C, (uint8_t[]){0x00, 0x00, 0x00, 0x00}, 4, 0},
};

// Guition's own BSP for this module: the panel keeps its tuning in OTP, so
// only sleep-out and display-on are sent.
static const axs15231b_lcd_init_cmd_t lcd_init_minimal[] = {
    {0x11, NULL, 0, 100},
    {0x29, NULL, 0, 100},
};

static bool IRAM_ATTR on_trans_done(esp_lcd_panel_io_handle_t, esp_lcd_panel_io_event_data_t *, void *) {
  BaseType_t woken = pdFALSE;
  xSemaphoreGiveFromISR(strip_free, &woken);
  return woken == pdTRUE;
}

void board_display_init(int variant) {
  ledc_timer_config_t tcfg = {};
  tcfg.speed_mode = LEDC_LOW_SPEED_MODE;
  tcfg.duty_resolution = LEDC_TIMER_8_BIT;
  tcfg.timer_num = LEDC_TIMER_0;
  tcfg.freq_hz = 20000;
  tcfg.clk_cfg = LEDC_AUTO_CLK;
  ledc_timer_config(&tcfg);
  ledc_channel_config_t ccfg = {};
  ccfg.gpio_num = PIN_LCD_BL;
  ccfg.speed_mode = LEDC_LOW_SPEED_MODE;
  ccfg.channel = LEDC_CHANNEL_0;
  ccfg.timer_sel = LEDC_TIMER_0;
  ccfg.duty = 0;
  ledc_channel_config(&ccfg);

  spi_bus_config_t bus = {};
  bus.sclk_io_num = PIN_LCD_SCK;
  bus.data0_io_num = PIN_LCD_D0;
  bus.data1_io_num = PIN_LCD_D1;
  bus.data2_io_num = PIN_LCD_D2;
  bus.data3_io_num = PIN_LCD_D3;
  bus.data4_io_num = -1;
  bus.data5_io_num = -1;
  bus.data6_io_num = -1;
  bus.data7_io_num = -1;
  bus.max_transfer_sz = STRIP_PIXELS * 2 + 64;
  ESP_ERROR_CHECK(spi_bus_initialize(SPI2_HOST, &bus, SPI_DMA_CH_AUTO));

  strip_free = xSemaphoreCreateCounting(2, 2);
  esp_lcd_panel_io_handle_t io = NULL;
  esp_lcd_panel_io_spi_config_t io_cfg = AXS15231B_PANEL_IO_QSPI_CONFIG(PIN_LCD_CS, on_trans_done, NULL);
  ESP_ERROR_CHECK(esp_lcd_new_panel_io_spi((esp_lcd_spi_bus_handle_t)SPI2_HOST, &io_cfg, &io));

  axs15231b_vendor_config_t vendor = {};
  if (variant == 3) {
    vendor.init_cmds = lcd_init_minimal;
    vendor.init_cmds_size = sizeof(lcd_init_minimal) / sizeof(lcd_init_minimal[0]);
  } else if (variant == 1) {
    vendor.init_cmds = lcd_init_type1;
    vendor.init_cmds_size = sizeof(lcd_init_type1) / sizeof(lcd_init_type1[0]);
  } else if (variant == 0) {
    vendor.init_cmds = lcd_init_cmds;
    vendor.init_cmds_size = sizeof(lcd_init_cmds) / sizeof(lcd_init_cmds[0]);
  }  // variant 2: driver's built-in sequence
  vendor.flags.use_qspi_interface = 1;
  esp_lcd_panel_dev_config_t pcfg = {};
  pcfg.reset_gpio_num = -1;
  pcfg.rgb_ele_order = LCD_RGB_ELEMENT_ORDER_RGB;
  pcfg.bits_per_pixel = 16;
  pcfg.vendor_config = &vendor;
  ESP_ERROR_CHECK(esp_lcd_new_panel_axs15231b(io, &pcfg, &panel));
  esp_lcd_panel_reset(panel);
  esp_lcd_panel_init(panel);
  // Don't call esp_lcd_panel_disp_on_off(panel, true): esp_lcd_axs15231b 2.1.1
  // treats that argument as "off" and sends DISPOFF, leaving the panel black.
  // Send DISPON (0x29) directly with the QSPI write-command framing instead.
  esp_lcd_panel_io_tx_param(io, (0x02 << 24) | (0x29 << 8), NULL, 0);
  vTaskDelay(pdMS_TO_TICKS(20));

  for (int i = 0; i < 2; i++)
    strip[i] = (uint16_t *)heap_caps_malloc(STRIP_PIXELS * 2, MALLOC_CAP_DMA | MALLOC_CAP_INTERNAL);
}

static bool take_strip(void) {
  if (xSemaphoreTake(strip_free, pdMS_TO_TICKS(300)) == pdTRUE) return true;
  g_flush_timeouts = g_flush_timeouts + 1;
  return false;
}

void board_display_draw(int, int, int, int, const uint16_t *fb) {
  int64_t t0 = esp_timer_get_time();
  // The AXS15231B in QSPI mode has no row-address command, so every frame is
  // written top to bottom in full-width strips (RAMWR then RAMWRC). This board
  // keeps a full framebuffer, so only whole frames arrive here.
  for (int s = 0; s < DISP_H / STRIP_ROWS; s++) {
    take_strip();
    uint16_t *dst = strip[s & 1];
    const uint16_t *src = fb + s * STRIP_PIXELS;
    for (int i = 0; i < STRIP_PIXELS; i++) dst[i] = __builtin_bswap16(src[i]);  // panel wants big-endian
    esp_lcd_panel_draw_bitmap(panel, 0, s * STRIP_ROWS, DISP_W, (s + 1) * STRIP_ROWS, dst);
  }
  bool a = take_strip(), b = take_strip();
  if (a) xSemaphoreGive(strip_free);
  if (b) xSemaphoreGive(strip_free);
  g_frames = g_frames + 1;
  g_flush_ms = (esp_timer_get_time() - t0) / 1000;
}

void board_backlight(uint8_t level) {
  ledc_set_duty(LEDC_LOW_SPEED_MODE, LEDC_CHANNEL_0, level);
  ledc_update_duty(LEDC_LOW_SPEED_MODE, LEDC_CHANNEL_0);
}

void board_touch_init(void) {
  i2c_master_bus_config_t bcfg = {};
  bcfg.i2c_port = I2C_NUM_0;
  bcfg.sda_io_num = PIN_TP_SDA;
  bcfg.scl_io_num = PIN_TP_SCL;
  bcfg.clk_source = I2C_CLK_SRC_DEFAULT;
  bcfg.glitch_ignore_cnt = 7;
  bcfg.flags.enable_internal_pullup = true;
  i2c_master_bus_handle_t bus;
  ESP_ERROR_CHECK(i2c_new_master_bus(&bcfg, &bus));
  i2c_device_config_t dcfg = {};
  dcfg.dev_addr_length = I2C_ADDR_BIT_LEN_7;
  dcfg.device_address = TP_ADDR;
  dcfg.scl_speed_hz = 400000;
  ESP_ERROR_CHECK(i2c_master_bus_add_device(bus, &dcfg, &tp_dev));
}

bool board_touch_read(int16_t *x, int16_t *y) {
  static const uint8_t cmd[11] = {0xB5, 0xAB, 0xA5, 0x5A, 0x00, 0x00, 0x00, 0x08, 0x00, 0x00, 0x00};
  uint8_t buf[8] = {0};
  if (i2c_master_transmit(tp_dev, cmd, sizeof(cmd), 30) != ESP_OK) return false;
  if (i2c_master_receive(tp_dev, buf, sizeof(buf), 30) != ESP_OK) return false;
  uint8_t points = buf[1];
  if (points == 0 || points > 4) return false;
  if ((buf[2] >> 6) == 1) return false;  // lift-off event
  int16_t tx = ((buf[2] & 0x0F) << 8) | buf[3];
  int16_t ty = ((buf[4] & 0x0F) << 8) | buf[5];
  if (tx >= DISP_W || ty >= DISP_H) return false;
  *x = tx;
  *y = ty;
  return true;
}
